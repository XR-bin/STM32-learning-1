#include "stm32f4xx.h"   
#include "led.h"
#include "beep.h"

static void dealy_ms(u32 ms)
{
	u32 i = 168 / 4 * 1000 * ms;
	while(i)
	{
		i--;
	}
}


/*****************************************************
*函数功能  ：对LED对应的GPIO口进行初始化设置
*函数名    ：LED_Init
*函数参数  ：void
*函数返回值：void
*描述      ：
*            LED1     PF6
*            LED2     PF9
*            LED3     PF10
*            LED4     PC0
*            高电平灭，低电平亮-----输出模式
********************************************************/
void LED_Init(void)
{
  //端口时钟使能   GPIOF  GPIOC
  RCC->AHB1ENR |= ((1<<5)|(1<<2));
  //端口模式配置
  GPIOF->MODER &= ~((3<<12)|(3<<18)|(3<<20));
  GPIOF->MODER |= ((1<<12)|(1<<18)|(1<<20));    //通用输出模式
  GPIOC->MODER &= ~(3<<0);
  GPIOC->MODER |= (1<<0);                       //通用输出模式
  //端口输出类型配置
  GPIOF->OTYPER &= ~((1<<6)|(1<<9)|(1<<10));    //推挽输出
  GPIOC->OTYPER &= ~(1<<0);                     //推挽输出
  //端口输出速度配置
  GPIOF->OSPEEDR &= ~((3<<12)|(3<<18)|(3<<20));  
  GPIOF->OSPEEDR |= ((2<<12)|(2<<18)|(2<<20));   //速度为50MHz 
  GPIOC->OSPEEDR &= ~(3<<0);
  GPIOC->OSPEEDR |= (2<<0);                      //速度为50MHz
  //端口输出数据寄存器配置   
	//先将LED都关闭
  GPIOF->ODR |= ((1<<6)|(1<<9)|(1<<10));         //高电平灭
  GPIOC->ODR |= (1<<0);                          //高电平灭
} 

/************************************************************
*函数功能  ：LED灯全亮
*函数名    ：LED_All_ON
*函数参数  ：void
*函数返回值：void
*描述      ：
***************************************************************/
void LED_All_ON(void)
{
  LED0_ON;
  LED1_ON;
  LED2_ON;
  LED3_ON;
}

/************************************************************
*函数功能  ：所有LED全灭
*函数名    ：LED_All_OFF
*函数参数  ：void
*函数返回值：void
*描述      ：
***************************************************************/
void LED_All_OFF(void)
{
  LED0_OFF;
  LED1_OFF;
  LED2_OFF;
  LED3_OFF;
}

/************************************************************
*函数功能  ：选择灯灭
*函数名    ：LED_All_ON
*函数参数  ：u8
*函数返回值：void
*描述      ：
***************************************************************/
void LED_X_ON(u8 n)
{
  switch(n)
  {
    case 0: LED0_ON;break;
    case 1: LED1_ON;break;
    case 2: LED2_ON;break;
    case 3: LED3_ON;break;
  }
}

/************************************************************
*函数功能  ：选择灯亮
*函数名    ：LED_All_OFF
*函数参数  ：u8
*函数返回值：void
*描述      ：
***************************************************************/
void LED_X_OFF(u8 n)
{
  switch(n)
  {
    case 0: LED0_OFF;break;
    case 1: LED1_OFF;break;
    case 2: LED2_OFF;break;
    case 3: LED3_OFF;break;
  }
}

/************************************************************
*函数功能  ：流水灯
*函数名    ：LED_Flash1
*函数参数  ：void
*函数返回值：void
*描述      ：
***************************************************************/
void LED_Flash1(void)
{
  static int i = 0;
  LED_X_ON(i);
  dealy_ms(1000);
  LED_X_OFF(i);
  i++;
  if(i>3)
  {
    i=0;
  }
}

/************************************************************
*函数功能  ：流水灯+蜂鸣器
*函数名    ：LED_Flash2
*函数参数  ：void
*函数返回值：void
*描述      ：
***************************************************************/
void LED_Flash2(int n)
{
  static int i = 0;
  static int cont = 0;
  static int c = 1;
  LED_X_ON(i);
  cont++;
  if(cont >= 1000000/2*n)
  {
    BEEP_OFF;
  }
  if(cont >= 10000*n)
  {
    LED_X_OFF(i);
    i++;
    if(i>3)
    {
      i=0;
    }
    BEEP_ON;
    c=!c;
    cont = 0;
  }
}

/************************************************************
*函数功能  ：流水灯
*函数名    ：LED_Flash3
*函数参数  ：int n
*函数返回值：void
*描述      ：
***************************************************************/
void LED_Flash3(int n)
{
  static int i = 0;
  static int cont = 0;
  
  LED_X_ON(i);
  cont++;
  
  if(cont >= 30000*n)
  {
    LED_X_OFF(i);
    i++;
    if(i>3)
    {
      i=0;
    }
    cont = 0;
  }
}







