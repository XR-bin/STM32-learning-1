#include "sys.h"

/************************************
*   F407的ADC时钟频率官方建议: 36Mhz
*   F103的ADC时钟频率官方建议: 14Mhz
*************************************/

/******************************************
*函数名    ：ADC3_Init_In6
*函数功能  ：ADC1的第五个通道初始化配置
*函数参数  ：void
*函数返回值：void 
*函数描述  ：
*          PF8----------ADC3_IN6   模拟模式
*********************************************/
void ADC3_Init_In6(void)
{
  /*GPIOx寄存器配置*/
  //GPIOx时钟使能
  RCC->APB2ENR |= (1<<7);
  //端口模式寄存器(模拟模式)
  GPIOF->CRH &= ~(0xf<<0);
  
  /*ADCx寄存器配置*/
  //ADCx时钟使能
  RCC->APB2ENR |= (1<<15);
  //ADC时钟预分频
  RCC->CFGR &= ~(3<<14);
  RCC->CFGR |= (2<<14);
//  //ADCx控制寄存器1   CR1
  ADC3->CR1 &= ~(0xffffffff);
//  //ADCx控制寄存器2   CR2
  ADC3->CR2 &= ~(0xffffffff);
	ADC3->CR2|=7<<17;	 
	ADC3->CR2|=1<<20; 
  //ADCx采样时间寄存
  ADC3->SMPR2 &= ~(7<<(3*6));
  ADC3->SMPR2 |= (7<<(3*6));
  //ADCx规则序列寄存器
  ADC3->SQR1 &= ~(0xf<<20);
  ADC3->SQR3 &= ~(0x1f<<0);
  ADC3->SQR3 |= (6<<0);
  
  //ADCx使能
  ADC3->CR2 |= (1<<0);  

  /*校准部分*/ 
	ADC3->CR2|=1<<3;       //使能复位校准  
	while(ADC1->CR2&1<<3); //等待校准结束 			 
    //该位由软件设置并由硬件清除。在校准寄存器被初始化后该位将被清除。 		 
	ADC3->CR2|=1<<2;        //开启AD校准	   
	while(ADC3->CR2&1<<2);  //等待校准结束
	//该位由软件设置以开始校准，并在校准结束时由硬件清除 
}

/******************************************
*函数名    ：ADC3_In6_Data
*函数功能  ：获取ADC3通道6的转换数据
*函数参数  ：void
*函数返回值：u16
*函数描述  ：用于转换光敏电阻数据
*********************************************/
u16 ADC3_In6_Data(void)
{
  u16 data;
  
  //开启规则通道转换开关
  ADC3->CR2 |= (1<<22);
  //等待转换完成
  while(!(ADC3->SR & (1<<1)));
  //读取转换后的数据
  data = ADC3->DR;
  
  return data;
}


