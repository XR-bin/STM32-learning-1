#include "sys.h"
#include "stdio.h"
#include "nvic.h"
#include "usart.h"
#include "delay.h"
#include "led.h"
#include "w25q128.h"

/*****************************************************
*函数功能  ：串口1中断服务函数
*函数名    ：USART1_IRQHandler
*函数参数  ：void
*函数返回值：void
*描述      ：
            PA9     TX     ---------输出
            PA10    RX     ---------输入
********************************************************/
void USART1_IRQHandler(void)
{
  //判断中断触发的形式
  if(USART1->SR & (1<<5))
  {
    //中断要执行的任务
    USART1->DR;
  }
  if(USART1->SR & (1<<4))
  {
    USART1->SR;
    USART1->DR;
  }
}

/*****************************************************
*函数功能  ：串口2中断服务函数
*函数名    ：USART2_IRQHandler
*函数参数  ：void
*函数返回值：void
*描述      ：
            PA2     TX     ---------输出
            PA3     RX     ---------输入
********************************************************/
void USART2_IRQHandler(void)
{
  //判断中断触发的形式
  if(USART2->SR & (1<<5))
  {
    //中断要执行的任务
    USART2->DR;
  }
}

/*****************************************************
*函数功能  ：外部中断服务函数
*函数名    ：EXTI4_IRQHandler
*函数参数  ：void
*函数返回值：void
*描述      ：
            按键0--------PE4
********************************************************/
void EXTI4_IRQHandler(void)
{
  if(EXTI->PR & (1<<4))
  {
    delay_ms(10);
    if(!(GPIOE->IDR & (1<<4)))
    {
      EXTI->PR |= (1<<4);
      GPIOB->ODR ^= (1<<5);
    }
  }
}

/******************************************************************
*函数功能  ：滴答定时中断服务函数
*函数名    ：EXTI0_IRQHandler
*函数参数  ：void
*函数返回值：void
*描述      ：
*******************************************************************/
void SysTick_Handler(void)
{
  if(SysTick->CTRL & (1<<16))
  {
    //将当前值寄存器清零   //随便写一个数据进入
    SysTick->VAL = 0xff;
    GPIOE->ODR ^= (1<<5);
  }
}


/******************************************************************
*函数功能  ：ADC3中断服务函数
*函数名    ：ADC3_IRQHandler
*函数参数  ：void
*函数返回值：void
*描述      ：
*******************************************************************/
void ADC3_IRQHandler(void)
{
  u16 data;
  if(ADC3->SR & (1<<1))
  { 
    //读取转换后的数据
    data = ADC3->DR;
    printf("data:%d\r\n",data);
  }
  //开启规则通道转换开关
  ADC3->CR2 |= (1<<22);
}

